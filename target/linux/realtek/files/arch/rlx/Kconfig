## target/linux/realtek/files/drivers/net/wireless/rtl8192cd/Kconfig
```kconfig
#
# Wireless LAN device configuration
#
config RTL8192CD
	tristate "RTL8192C/D 802.11b/g/n support"

##########################################################################
# Select WiFi device on Lextra Bus
##########################################################################
#config USE_Lextra_BUS
#	bool "USE Lextra BUS WiFi device"
#	depends on CONFIG_RTL_8881A && RTL8192CD
#	default n

#choice
#	prompt "Lextra BUS device"
#	depends on USE_Lextra_BUS
#	default LBUS_8881A

#config LBUS_8881A
#        bool "Realtek 8881A wireless support "
#		select RTL_ODM_WLAN_DRIVER
#endchoice

config WLAN_HAL_8881A
        bool "Realtek 8881A wireless support "
	depends on RTL_8881A && RTL8192CD
	select RTL_ODM_WLAN_DRIVER
	default y
config RTL_8881A_SELECTIVE
	bool "Realtek 8881A selective support "
	depends on WLAN_HAL_8881A && !(RTL_88E_SUPPORT || WLAN_HAL_8192EE)
	default y	
choice
	prompt "Register parameter"
	depends on RTL_8881A
	default MAC_PHY_RF_Parameter_V702B_Skyworth

	config MAC_PHY_RF_Parameter_V700
        bool "MAC PHY RF Parameter V700"

	config MAC_PHY_RF_Parameter_V702B
        bool "MAC PHY RF Parameter V702B"

	config MAC_PHY_RF_Parameter_V702B_Skyworth
        bool "MAC PHY RF Parameter V702B Skyworth"

#	config MAC_PHY_RF_Parameter_V702B_MP
#	bool "MAC PHY RF Parameter V702B MP"
endchoice

##########################################################################
# Select WiFi device on PCIe slot 0
##########################################################################

config USE_PCIE_SLOT_0
	bool "Use PCIe slot 0 WiFi device"
	depends on RTL8192CD
	default y

choice
	prompt "PCIe Slot 0 device"
	depends on USE_PCIE_SLOT_0
	default SLOT_0_92C

config SLOT_0_8192EE
        bool "Realtek 8192EE wireless support "
	select RTL_ODM_WLAN_DRIVER

config SLOT_0_92C
        bool "Realtek 8192C wireless support "

config SLOT_0_92D
	bool "Realtek 8192D wireless support"
	select RTL_5G_SLOT_0

config RTL_92D_DMDP
	bool "RTL8192D dual-MAC-dual-PHY mode"
	depends on SLOT_0_92D
	default y if (!RTL_8198 && !RTL_8197D && !RTL_8197DL)

config SLOT_0_88E
        bool "Realtek 8188E wireless support"

config SLOT_0_8812
	bool "Realtek 8812 wireless support"
	select RTL_5G_SLOT_0
config SLOT_0_8812AR_VN
	bool "Realtek 8812AR-VN wireless support"
	select RTL_5G_SLOT_0
endchoice

config SLOT_0_EXT_PA
	bool "PCIe slot 0 Enable external high power PA"
	depends on USE_PCIE_SLOT_0
	default n

config SLOT_0_EXT_LNA
	bool "PCIe slot 0 Enable external LNA"
	depends on USE_PCIE_SLOT_0 && (SLOT_0_92C || SLOT_0_8812 || SLOT_0_8812AR_VN)
	default n

##########################################################################
# Select WiFi device on PCIe slot 1
##########################################################################

config USE_PCIE_SLOT_1
	bool "Use PCIe slot 1 WiFi device"
	depends on RTL8192CD && (RTL_8198 || RTL_8197D || RTL_8197DL)
	default y

choice
	prompt "PCIe Slot 1 device"
	depends on USE_PCIE_SLOT_1
	default SLOT_1_92D

config SLOT_1_92C
	bool "Realtek 8192C wireless support"

config SLOT_1_92D
	bool "Realtek 8192D wireless support"
	select RTL_5G_SLOT_1

#config RTL_92D_DMDP
#	bool "RTL8192D dual-MAC-dual-PHY mode"
#	depends on SLOT_1_92D
#	default y

config SLOT_1_88E
	bool "Realtek 8188E wireless support"

config SLOT_1_8812
	bool "Realtek 8812 wireless support"
	select RTL_5G_SLOT_1

config SLOT_1_8192EE
        bool "Realtek 8192EE wireless support "
        select RTL_ODM_WLAN_DRIVER

config SLOT_1_8812AR_VN
	bool "Realtek 8812AR-VN wireless support"
	select RTL_5G_SLOT_1
endchoice


config SLOT_1_EXT_PA
	bool "PCIe slot 1 Enable external high power PA"
	depends on USE_PCIE_SLOT_1
	default n

config SLOT_1_EXT_LNA
	bool "PCIe slot 1 Enable external LNA"
	depends on USE_PCIE_SLOT_1 && (SLOT_1_92C || SLOT_1_8812 || SLOT_1_8812AR_VN)
	default n

##########################################################################
# Select interface config
##########################################################################

###### WLAN_HAL relative configuration

config WLAN_HAL
	bool
	default y if (WLAN_HAL_8192EE || WLAN_HAL_8881A)

config WLAN_HAL_88XX
	bool
	default y if (WLAN_HAL_8192EE || WLAN_HAL_8881A)

config WLAN_HAL_8192EE
	bool
	default y if (SLOT_0_8192EE || SLOT_1_8192EE)

###### End------WLAN_HAL relative configuration

config RTL_92C_SUPPORT
	bool
	default y if (SLOT_0_92C || SLOT_1_92C)

config RTL_92D_SUPPORT
	bool
	default y if (SLOT_0_92D || SLOT_1_92D)

config RTL_88E_SUPPORT
	bool
        select RTL_ODM_WLAN_DRIVER
	default y if (SLOT_0_88E || SLOT_1_88E)

config RTL_8812_SUPPORT
	bool
	select RTL_ODM_WLAN_DRIVER
#	select CONFIG_RTL_DUAL_92C_8812E
	default y if (SLOT_0_8812 || SLOT_1_8812 || SLOT_0_8812AR_VN || SLOT_1_8812AR_VN  )

config RTL_8812AR_VN_SUPPORT
	bool
	default y if ( SLOT_0_8812AR_VN || SLOT_1_8812AR_VN )
#
# General options
#

config RTL_8812_1T1R_SUPPORT
	bool "Realtek 8812 1T1R mode"
	depends on RTL_8812_SUPPORT
	default n

config RTL_HOSTAPD_SUPPORT
	bool "Realtek hostapd support"
	depends on RTL8192CD && RTL_92C_SUPPORT && !RTL_8812_SUPPORT
	default n

#config HIGH_POWER_EXT_PA
#	bool "Enable external high power PA"
#	depends on RTL8192CD && !RTL_88E_SUPPORT
#	default n

#config HIGH_POWER_EXT_LNA
#	bool "Enable external LNA"
#	depends on RTL8192CD && RTL_92C_SUPPORT
#	default n

config 	ANT_SWITCH
	bool "Enable Antenna Diversity"
	depends on RTL8192CD && !RTL_88E_SUPPORT && !RTL_8812_SUPPORT
	default n

#config RTL_DUAL_PCIESLOT_BIWLAN
#	bool "Enable both of the 2 pcie slot for bi-8192C support"
#	depends on RTL8192CD && RTL_8198 && !RTL_92D_SUPPORT && !RTL_88E_SUPPORT && !RTL_8812_SUPPORT
#	default n

#config RTL_92D_SUPPORT
#	bool "Realtek 8192D wireless support "
#	depends on RTL8192CD && !RTL_88E_SUPPORT && !RTL_8812_SUPPORT
#	default n

#config PCIE_POWER_SAVING
#	bool "Enable PCIE power saving support"
#	depends on RTL8192CD && !RTL_88E_SUPPORT && !RTL_8812_SUPPORT
#	default y if CONFIG_RTL8196C

#config RTL_92D_DMDP
#	bool "RTL8192D dual-MAC-dual-PHY mode"
#	depends on RTL8192CD && RTL_92D_SUPPORT && !RTL_DUAL_PCIESLOT_BIWLAN_D
#	default y

config USB_POWER_BUS
	bool "Use USB Power"
	depends on RTL8192CD && RTL_92D_SUPPORT && !RTL_92C_SUPPORT 
	default n

config RTL_DFS_SUPPORT
	bool "DFS Support"
        depends on RTL8192CD && (RTL_92D_SUPPORT || RTL_8812_SUPPORT || WLAN_HAL_8881A)
        default n

#config RTL_TX_EARLY_MODE_SUPPORT
#	bool "Tx Early Mode Support"
#	depends on RTL8192CD && RTL_92D_SUPPORT
#	default n

#config RTL_DUAL_PCIESLOT_BIWLAN_D
#	bool "Support Dual card:92C+92D"
#	depends on RTL8192CD && !RTL_88E_SUPPORT && !RTL_8812_SUPPORT
#	select RTL_92C_SUPPORT
#	select RTL_92D_SUPPORT
#	default n

#config RTL_DUAL_92C_8812E
#	bool "Support Dual card:92C+8812E"
#	depends on RTL8192CD
#	select RTL_92C_SUPPORT
#	select RTL_8812_SUPPORT
#	default n

config RTL8190_PRIV_SKB
        bool "Private skb buffer management"
        depends on RTL8192CD
        default y

config RTL_VAP_SUPPORT
        bool "Virtual AP Support"
        depends on RTL8192CD
        default y

config RTL_CLIENT_MODE_SUPPORT
        bool "Client Mode Support"
        depends on RTL8192CD
        default y

config RTL_REPEATER_MODE_SUPPORT
	bool "Repeater Mode support"
	depends on RTL8192CD && RTL_CLIENT_MODE_SUPPORT
	default y

config RTL_802_1X_CLIENT_SUPPORT
	bool "Client Mode 802.1x Support"
	depends on RTL8192CD && RTL_CLIENT_MODE_SUPPORT
	default n

config RTL_SUPPORT_MULTI_PROFILE
	bool "Multiple AP profile Support"
	depends on RTL8192CD && RTL_CLIENT_MODE_SUPPORT
	default y

config RTL_WDS_SUPPORT
        bool "WDS Support"
        depends on RTL8192CD
        default y

config ENABLE_EFUSE
	bool "Efuse Support"
	depends on RTL8192CD
	default n

config RTL_WAPI_SUPPORT
	bool "WAPI Support"
	depends on RTL8192CD 
	default n

config  RTL_WAPI_LOCAL_AS_SUPPORT
        bool "support local AS"
        depends on RTL8192CD && RTL_WAPI_SUPPORT 
        default n

config RTL_COMAPI_CFGFILE
        bool "Config File support"
        depends on RTL8192CD 
        default n

config RTL_COMAPI_WLTOOLS
        bool "Wireless Tools v29 support"
        depends on RTL8192CD && !RTL_8812_SUPPORT
        default n

#config WIRELESS_LAN_MODULE
#	bool
#	default y if RTL8192CD=m

config MP_PSD_SUPPORT
        bool "MP quick PSD support"
        depends on RTL8192CD && !RTL_88E_SUPPORT
        default n

config RTL_P2P_SUPPORT
	bool "Realtek P2P support "
	depends on RTL8192CD && !RTL_88E_SUPPORT && !RTL_8812_SUPPORT
	default n

config RTL_WPS2_SUPPORT
	bool "Realtek wps2.0 support "
	depends on RTL8192CD
	default y

config PHY_EAT_40MHZ
	bool "Clock Source, Select is 40MHz, otherwise 25MHz"
	depends on RTL8192CD && !AUTO_PCIE_PHY_SCAN
	default y
config 	ANT_SWITCH
	bool "Enable Antenna Diversity"
	depends on RTL8192E 
	default n

config TXPWR_LMT
	bool "Band Edge Limit support for 92C/92D/8812/88E/92E/8881A"
	depends on RTL_92C_SUPPORT || RTL_92D_SUPPORT || RTL_8812_SUPPORT || RTL_88E_SUPPORT|| WLAN_HAL_8192EE || WLAN_HAL_8881A
	default n

config RTL_MESH_SUPPORT
	bool "RTL Mesh Support"
	depends on RTL8192CD && !RTL_88E_SUPPORT && !RTL_8812_SUPPORT
	default n

config RTL_WLAN_DOS_FILTER
	bool "Enable WLAN DoS Filter"
	depends on RTL8192CD && !RTL_88E_SUPPORT && !RTL_8812_SUPPORT
	default n

##########################################################################
# Select WiFi Band on Wlan0
##########################################################################

#choice
#	prompt "Select WiFi Band on Wlan0"
#	depends on USE_PCIE_SLOT_0
#	default BAND_2G_ON_WLAN0

#config BAND_2G_ON_WLAN0
#	bool "Select 2.4g band on wlan0"

config BAND_5G_ON_WLAN0
#	bool "Select 5g band on wlan0"
	bool
	default y
	
#endchoice

#config RTL_ODM_WLAN_DRIVER
#	bool "Enable outsource dynamic mechanism driver"
#	depends on RTL8192CD && (RTL_88E_SUPPORT || RTL_8812_SUPPORT)
#	default y

#
# Hidden options
#
config WIRELESS_LAN_MODULE
	bool
	default y if RTL8192CD=m

config RTL_5G_SLOT_0
	bool

config RTL_5G_SLOT_1
	bool

config RTL_ODM_WLAN_DRIVER
	bool

config RTL_WLAN_HAL_NOT_EXIST
	bool
	depends on (RTL_92C_SUPPORT || RTL_92D_SUPPORT || RTL_88E_SUPPORT || RTL_8812_SUPPORT)
	default y 
```

## target/linux/realtek/files/drivers/usb/dwc_otg/Kconfig
```kconfig
config DWC_OTG
        tristate "Synopsys DWC_OTG support"
        ---help---
          This driver supports Synopsys DWC_OTG 

config DWC_OTG_DEBUG
        bool "enable debug mode"
        depends on DWC_OTG


config DWC_OTG_HOST_ONLY
        bool "HOST ONLY MODE"
        depends on DWC_OTG

config DWC_OTG_DEVICE_ONLY
        bool "DEVICE ONLY MODE"
        depends on DWC_OTG

config RTL_OTGCTRL
        bool "Enable Realtek usb auto_det control circuit"
        
```

## target/linux/realtek/files/drivers/usb/misc/rts51xx/Kconfig
```kconfig
config RTS51XX
	tristate "Realtek RTS5139/29 USB card reader support"
	depends on USB && SCSI
	help
	  Say Y here to include driver code to support the Realtek
	  RTS51xx USB card readers.

	  If this driver is compiled as a module, it will be named rts5139.
```

## target/linux/realtek/image/Config.in
```kconfig
config REALTEK_KERNEL_LOAD_ADDRESS
	string "Load address of kernel in ram"
	depends TARGET_realtek
	default "0x80500000"

config REALTEK_KERNEL_OFFSET
	string "Offset of kernel in flash rom (HEX)"
	depends TARGET_realtek
	default "30000"

config REALTEK_ROOTFS_OFFSET
	string "Offset of filesystem in flash rom (HEX)"
	depends TARGET_realtek
	default "1b0000"

config REALTEK_FLASH_SIZE
	string "size of the flash rom"
	depends TARGET_realtek
	default "0x800000"

config REALTEK_FLATFS_IMAGE_OFFSET
	string "FLATFS image offset in flash"
	depends TARGET_realtek
	default "0x3E0000"
```
